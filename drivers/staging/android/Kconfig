## drivers/staging/android/Kconfig
```kconfig
menu "Android"

config ANDROID
	bool "Android Drivers"
	default N
	---help---
	  Enable support for various drivers needed on the Android platform

config ANDROID_BINDER_IPC
	bool "Android Binder IPC Driver"
	default n

endmenu
```
